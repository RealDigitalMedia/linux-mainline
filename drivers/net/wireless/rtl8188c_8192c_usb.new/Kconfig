## drivers/net/wireless/rtl8188c_8192c_usb.new/Kconfig
```kconfig
config RTL8192CU
	tristate "Realtek 8192C/8188CUS USB WiFi"
	depends on USB
	---help---
	  Help message of RTL8192CU
```

## drivers/net/wireless/rtl8188c_8192c_usb/Kconfig
```kconfig
config RTL8192CU
	tristate "Realtek 8188CUS USB WiFi"
	depends on USB
	---help---
	  Help message of RTL8188CUS
```
